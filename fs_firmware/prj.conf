## CMakeLists.txt
```
# SPDX-License-Identifier: Apache-2.0

cmake_minimum_required(VERSION 3.20.0)
find_package(Zephyr REQUIRED HINTS $ENV{ZEPHYR_BASE})
project(fs_firmware)

target_sources(app PRIVATE
    src/main.c
    src/fs_log.c
)

target_include_directories(app PRIVATE
    ${CMAKE_CURRENT_SOURCE_DIR}/src
)
```

## prj.conf
```kconfig
# -----------------------------
# Logging / Console / Shell
# -----------------------------
CONFIG_LOG=y
CONFIG_LOG_DEFAULT_LEVEL=3
CONFIG_PRINTK=y
CONFIG_STDOUT_CONSOLE=y
CONFIG_SERIAL=y
CONFIG_UART_CONSOLE=y

CONFIG_SHELL=y
CONFIG_SHELL_BACKEND_SERIAL=y
CONFIG_SHELL_STACK_SIZE=4096

# -----------------------------
# Kernel
# -----------------------------
CONFIG_MAIN_STACK_SIZE=4096
CONFIG_HEAP_MEM_POOL_SIZE=8192

# -----------------------------
# Flash + Storage partition
# -----------------------------
CONFIG_FLASH=y
CONFIG_FLASH_MAP=y
CONFIG_FLASH_PAGE_LAYOUT=y
CONFIG_MPU_ALLOW_FLASH_WRITE=y

# -----------------------------
# File system (LittleFS)
# -----------------------------
CONFIG_FILE_SYSTEM=y
CONFIG_FILE_SYSTEM_LITTLEFS=y

# Built-in fs shell (ls, cat, rm, mkdir, mount, ...)
CONFIG_FILE_SYSTEM_SHELL=y

# -----------------------------
# printk / float formatting
# -----------------------------
CONFIG_PICOLIBC_IO_FLOAT=y
CONFIG_CBPRINTF_FP_SUPPORT=y
```

## src/main.c
```c
/*
 * fs_firmware - Demonstrates LittleFS-backed logging on Zephyr.
 *
 * On boot we mount the filesystem, append a boot marker line, and print
 * filesystem statistics. The `fslog` shell command (registered in fs_log.c)
 * and the built-in `fs` shell can then be used at runtime to write/read
 * log entries and manage files.
 */

#include <zephyr/kernel.h>
#include <zephyr/sys/printk.h>
#include <zephyr/fs/fs.h>
#include <zephyr/logging/log.h>

#include "fs_log.h"

LOG_MODULE_REGISTER(main, LOG_LEVEL_INF);

#define BOOT_COUNT_PATH FS_LOG_MOUNT_POINT "/boot.cnt"

/* Read the boot counter from the FS, increment it, and write it back.
 * Returns the new boot count, or a negative errno on failure.
 */
static int update_boot_counter(void)
{
    struct fs_file_t f;
    uint32_t count = 0;

    fs_file_t_init(&f);
    int rc = fs_open(&f, BOOT_COUNT_PATH, FS_O_READ);
    if (rc == 0) {
        (void)fs_read(&f, &count, sizeof(count));
        (void)fs_close(&f);
    } else if (rc != -ENOENT) {
        return rc;
    }

    count++;

    fs_file_t_init(&f);
    rc = fs_open(&f, BOOT_COUNT_PATH, FS_O_CREATE | FS_O_WRITE);
    if (rc < 0) {
        return rc;
    }
    ssize_t w = fs_write(&f, &count, sizeof(count));
    (void)fs_sync(&f);
    (void)fs_close(&f);
    if (w < 0) {
        return (int)w;
    }
    return (int)count;
}

int main(void)
{
    printk("\n=== fs_firmware starting ===\n");

    int rc = fs_log_init();
    if (rc < 0) {
        printk("fs_log_init failed: %d\n", rc);
        return 0;
    }

    int boot_no = update_boot_counter();
    if (boot_no < 0) {
        printk("update_boot_counter failed: %d\n", boot_no);
        boot_no = 0;
    }

    rc = fs_log_writef("boot #%d uptime=%lld ms", boot_no, k_uptime_get());
    if (rc < 0) {
        printk("fs_log_writef failed: %d\n", rc);
    } else {
        printk("Logged boot marker (%d bytes)\n", rc);
    }

    size_t total = 0, used = 0;
    if (fs_log_stats(&total, &used) == 0) {
        printk("LittleFS: total=%u used=%u free=%u bytes\n",
               (unsigned int)total, (unsigned int)used,
               (unsigned int)(total - used));
    }

    int sz = fs_log_file_size();
    if (sz >= 0) {
        printk("Log file size: %d bytes\n", sz);
    }

    printk("Type `fslog read` to print the log, `fslog write <text>` to append,\n"
           "`fslog clear` to wipe it, or use the built-in `fs` shell to browse.\n");

    /* Heartbeat - keep the main thread alive so the shell stays responsive. */
    while (1) {
        k_sleep(K_SECONDS(60));
    }
    return 0;
}
```

## src/ble_central.c
```c
#include <stddef.h>
#include <stdio.h>
#include <errno.h>
#include <stdlib.h>

#include <zephyr/kernel.h>
#include <zephyr/sys/printk.h>
#include <zephyr/bluetooth/bluetooth.h>
#include <zephyr/bluetooth/hci.h>
#include <zephyr/bluetooth/conn.h>
#include <zephyr/bluetooth/uuid.h>
#include <zephyr/bluetooth/gatt.h>
#include <zephyr/bluetooth/services/nus.h>
#include <zephyr/sys/byteorder.h>
#include <zephyr/types.h>
#include <zephyr/sys/uuid.h>

#include "ble_central.h"

#define MAX_CONNECTIONS 2

typedef void (*nus_data_cb_t)(const void *data, uint16_t len);

typedef struct {
    bt_addr_le_t target_addr;
    struct bt_conn *conn;
    struct bt_uuid_128 discover_uuid;
    struct bt_uuid_16 discover_ccc_uuid;
    struct bt_gatt_discover_params discover_params;
    struct bt_gatt_subscribe_params subscribe_params;
    struct bt_gatt_exchange_params mtu_params;
    nus_data_cb_t data_cb;
    bool in_use;
    uint16_t rx_handle;
    bool is_sender;
} ble_ctx_t;

static ble_ctx_t clients[MAX_CONNECTIONS];
static uint8_t volatile conn_count;

/* Nordic UART Service UUIDs */
static struct bt_uuid_128 nus_svc_uuid = BT_UUID_INIT_128(BT_UUID_NUS_SRV_VAL);
static struct bt_uuid_128 nus_tx_uuid = BT_UUID_INIT_128(BT_UUID_NUS_TX_CHAR_VAL);
static struct bt_uuid_128 nus_rx_uuid = BT_UUID_INIT_128(BT_UUID_NUS_RX_CHAR_VAL);

static void start_scan(void);

static void device_found(const bt_addr_le_t *addr, int8_t rssi, uint8_t type,
                         struct net_buf_simple *ad)
{
    char addr_str[BT_ADDR_LE_STR_LEN];
    int err;

    if (type != BT_GAP_ADV_TYPE_ADV_IND && type != BT_GAP_ADV_TYPE_ADV_DIRECT_IND) {
        return;
    }

    bt_addr_le_to_str(addr, addr_str, sizeof(addr_str));

    /* check if this address matches any registered client slot */
    ble_ctx_t *ctx = NULL;
    for (int i = 0; i < MAX_CONNECTIONS; i++) {
        if (clients[i].in_use && clients[i].conn == NULL) {
            char target_str[BT_ADDR_LE_STR_LEN];
            bt_addr_le_to_str(&clients[i].target_addr, target_str, sizeof(target_str));
            if (strncmp(addr_str, target_str, strlen(target_str)) == 0) {
                ctx = &clients[i];
                break;
            }
        }
    }

    if (!ctx) {
        return;
    }

    if (bt_le_scan_stop()) {
        return;
    }

    err = bt_conn_le_create(addr, BT_CONN_LE_CREATE_CONN, BT_LE_CONN_PARAM_DEFAULT, &ctx->conn);
    if (err) {
        printk("Create conn to %s failed (%d)\n", addr_str, err);
        start_scan();
    }
}

static uint8_t notify_func(struct bt_conn *conn, struct bt_gatt_subscribe_params *params,
                           const void *data, uint16_t length)
{
    ble_ctx_t *ctx = CONTAINER_OF(params, ble_ctx_t, subscribe_params);

    if (!data) {
        printk("[UNSUBSCRIBED]\n");
        params->value_handle = 0U;
        return BT_GATT_ITER_STOP;
    }

    if (ctx->data_cb) {
        ctx->data_cb(data, length);
    }

    return BT_GATT_ITER_CONTINUE;
}

static uint8_t discover_func(struct bt_conn *conn, const struct bt_gatt_attr *attr,
                             struct bt_gatt_discover_params *params)
{
    ble_ctx_t *ctx = CONTAINER_OF(params, ble_ctx_t, discover_params);

    int err;

    if (!attr) {
        printk("Discover complete\n");
        (void)memset(params, 0, sizeof(*params));
        return BT_GATT_ITER_STOP;
    }

    if (!bt_uuid_cmp(ctx->discover_params.uuid, &nus_svc_uuid.uuid)) {

        if (ctx->is_sender) {
            memcpy(&ctx->discover_uuid, &nus_rx_uuid.uuid, sizeof(ctx->discover_uuid));
        } else {
            memcpy(&ctx->discover_uuid, &nus_tx_uuid.uuid, sizeof(ctx->discover_uuid));
        }

        ctx->discover_params.uuid = &ctx->discover_uuid.uuid;
        ctx->discover_params.start_handle = attr->handle + 1;
        ctx->discover_params.type = BT_GATT_DISCOVER_CHARACTERISTIC;

        err = bt_gatt_discover(conn, &ctx->discover_params);
        if (err) {
            printk("Discover failed (err %d)\n", err);
        }
    } else if (!bt_uuid_cmp(ctx->discover_params.uuid, &nus_rx_uuid.uuid)) {
        ctx->rx_handle = bt_gatt_attr_value_handle(attr);
        printk("[SENDER READY] rx_handle = %u\n", ctx->rx_handle);
        return BT_GATT_ITER_STOP;
    } else if (!bt_uuid_cmp(ctx->discover_params.uuid, &nus_tx_uuid.uuid)) {
        // found TX; find CCC
        memcpy(&ctx->discover_ccc_uuid.uuid, BT_UUID_GATT_CCC, sizeof(ctx->discover_ccc_uuid));
        ctx->discover_params.uuid = &ctx->discover_ccc_uuid.uuid;
        ctx->discover_params.start_handle = bt_gatt_attr_value_handle(attr) + 1;
        ctx->discover_params.type = BT_GATT_DISCOVER_DESCRIPTOR;
        ctx->subscribe_params.value_handle = bt_gatt_attr_value_handle(attr);

        err = bt_gatt_discover(conn, &ctx->discover_params);
        if (err) {
            printk("Discover failed (err %d)\n", err);
        }
    } else {
        ctx->subscribe_params.notify = notify_func;
        ctx->subscribe_params.value = BT_GATT_CCC_NOTIFY;
        ctx->subscribe_params.ccc_handle = attr->handle;

        err = bt_gatt_subscribe(conn, &ctx->subscribe_params);
        if (err && err != -EALREADY) {
            printk("Subscribe failed (err %d)\n", err);
        } else {
            printk("[SUBSCRIBED]\n");
        }

        return BT_GATT_ITER_STOP;
    }

    return BT_GATT_ITER_STOP;
}

static void start_scan(void)
{
    int err;
    err = bt_le_scan_start(BT_LE_SCAN_PASSIVE, device_found);
    if (err) {
        printk("Scanning failed to start (err %d)\n", err);
        return;
    }
}

static ble_ctx_t *get_ctx_by_conn(struct bt_conn *conn)
{
    for (int i = 0; i < MAX_CONNECTIONS; i++) {
        if (clients[i].conn == conn) {
            return &clients[i];
        }
    }
    return NULL;
}

static void mtu_exchange_cb(struct bt_conn *conn, uint8_t err,
                            struct bt_gatt_exchange_params *params)
{
    printk("MTU exchange %s (%u)\n", err == 0U ? "successful" : "failed", bt_gatt_get_mtu(conn));
}

static int mtu_exchange(struct bt_conn *conn, ble_ctx_t *ctx)
{

    ctx->mtu_params.func = mtu_exchange_cb;
    int err = bt_gatt_exchange_mtu(conn, &ctx->mtu_params);

    if (err) {
        printk("MTU exchange failed (err %d)\n", err);
    }

    return err;
}

static void connected(struct bt_conn *conn, uint8_t err)
{
    char addr[BT_ADDR_LE_STR_LEN];
    bt_addr_le_to_str(bt_conn_get_dst(conn), addr, sizeof(addr));

    ble_ctx_t *ctx = get_ctx_by_conn(conn);
    if (!ctx) {
        return;
    }

    if (err) {
        printk("Failed to connect to %s %u %s\n", addr, err, bt_hci_err_to_str(err));
        bt_conn_unref(ctx->conn);
        ctx->conn = NULL;
        start_scan();
        return;
    }

    printk("Connected: %s\n", addr);
    conn_count++;

    mtu_exchange(conn, ctx);

    memcpy(&ctx->discover_uuid, BT_UUID_NUS_SERVICE, sizeof(ctx->discover_uuid));
    ctx->discover_params.uuid = &ctx->discover_uuid.uuid;
    ctx->discover_params.func = discover_func;
    ctx->discover_params.start_handle = BT_ATT_FIRST_ATTRIBUTE_HANDLE;
    ctx->discover_params.end_handle = BT_ATT_LAST_ATTRIBUTE_HANDLE;
    ctx->discover_params.type = BT_GATT_DISCOVER_PRIMARY;

    err = bt_gatt_discover(conn, &ctx->discover_params);
    if (err) {
        printk("Discover failed(err %d)\n", err);
        return;
    }

    if (conn_count < MAX_CONNECTIONS) {
        start_scan();
    }
}

static void disconnected(struct bt_conn *conn, uint8_t reason)
{
    char addr[BT_ADDR_LE_STR_LEN];
    bt_addr_le_to_str(bt_conn_get_dst(conn), addr, sizeof(addr));
    ble_ctx_t *ctx = get_ctx_by_conn(conn);

    if (!ctx) {
        return;
    }

    printk("Disconnected: %s, reason 0x%02x %s\n", addr, reason, bt_hci_err_to_str(reason));

    bt_conn_unref(ctx->conn);
    ctx->conn = NULL;
    conn_count--;

    start_scan();
}

BT_CONN_CB_DEFINE(conn_callbacks) = {
    .connected = connected,
    .disconnected = disconnected,
};

int ble_add(const char *addr_str, nus_data_cb_t cb, bool is_sender)
{
    for (int i = 0; i < MAX_CONNECTIONS; i++) {
        if (!clients[i].in_use) {
            bt_addr_le_from_str(addr_str, "random", &clients[i].target_addr);
            clients[i].data_cb = cb;
            clients[i].in_use = true;
            clients[i].conn = NULL;
            clients[i].is_sender = is_sender;
            clients[i].rx_handle = 0;
            return 0;
        }
    }
    return -ENOMEM;
}

int ble_start(void)
{
    int err = bt_enable(NULL);
    if (err) {
        printk("Bluetooth init failed (err %d)\n", err);
        return err;
    }

    printk("Bluetooth initialized\n");
    start_scan();
    return 0;
}

int ble_send(const char *addr_str, const void *data, uint16_t len)
{
    for (int i = 0; i < MAX_CONNECTIONS; i++) {
        if (!clients[i].in_use || !clients[i].conn || clients[i].rx_handle == 0) {
            continue;
        }
        char target_str[BT_ADDR_LE_STR_LEN];
        bt_addr_le_to_str(&clients[i].target_addr, target_str, sizeof(target_str));
        if (strncmp(target_str, addr_str, strlen(addr_str)) == 0) {
            return bt_gatt_write_without_response(clients[i].conn, clients[i].rx_handle, data, len,
                                                  false);
        }
    }
    return -ENODEV;
}
```

## src/fs_log.c
```c
/*
 * fs_log.c - LittleFS-backed append-only line logger.
 */

#include "fs_log.h"

#include <zephyr/kernel.h>
#include <zephyr/device.h>
#include <zephyr/fs/fs.h>
#include <zephyr/fs/littlefs.h>
#include <zephyr/storage/flash_map.h>
#include <zephyr/logging/log.h>

#include <stdarg.h>
#include <stdio.h>
#include <string.h>
#include <errno.h>

LOG_MODULE_REGISTER(fs_log, LOG_LEVEL_INF);

/*
 * Use the `storage_partition` label that virtually every Zephyr board
 * defines in its DTS. If the target board does not define one, add a
 * board overlay defining a fixed-partition with label "storage".
 */
#define STORAGE_PARTITION       storage_partition
#define STORAGE_PARTITION_ID    FIXED_PARTITION_ID(STORAGE_PARTITION)

/* LittleFS configuration for the storage partition. */
FS_LITTLEFS_DECLARE_DEFAULT_CONFIG(fs_log_lfs_cfg);

static struct fs_mount_t fs_log_mnt = {
    .type = FS_LITTLEFS,
    .fs_data = &fs_log_lfs_cfg,
    .storage_dev = (void *)STORAGE_PARTITION_ID,
    .mnt_point = FS_LOG_MOUNT_POINT,
};

static K_MUTEX_DEFINE(fs_log_mutex);
static bool fs_log_mounted;

/* -------------------------------------------------------------------------- */
/* Internal helpers                                                            */
/* -------------------------------------------------------------------------- */

static int ensure_log_file(void)
{
    struct fs_file_t f;
    fs_file_t_init(&f);

    /* Open for append; creates the file if it does not already exist. */
    int rc = fs_open(&f, FS_LOG_FILE_PATH, FS_O_CREATE | FS_O_WRITE | FS_O_APPEND);
    if (rc < 0) {
        LOG_ERR("Unable to create log file %s (%d)", FS_LOG_FILE_PATH, rc);
        return rc;
    }
    (void)fs_close(&f);
    return 0;
}

/* -------------------------------------------------------------------------- */
/* Public API                                                                  */
/* -------------------------------------------------------------------------- */

int fs_log_init(void)
{
    int rc;

    k_mutex_lock(&fs_log_mutex, K_FOREVER);

    if (fs_log_mounted) {
        k_mutex_unlock(&fs_log_mutex);
        return 0;
    }

    rc = fs_mount(&fs_log_mnt);
    if (rc < 0) {
        LOG_ERR("fs_mount(%s) failed: %d", fs_log_mnt.mnt_point, rc);
        k_mutex_unlock(&fs_log_mutex);
        return rc;
    }

    LOG_INF("Mounted LittleFS at %s", fs_log_mnt.mnt_point);
    fs_log_mounted = true;

    rc = ensure_log_file();
    if (rc < 0) {
        /* Roll back the mount so we can retry later. */
        (void)fs_unmount(&fs_log_mnt);
        fs_log_mounted = false;
        k_mutex_unlock(&fs_log_mutex);
        return rc;
    }

    k_mutex_unlock(&fs_log_mutex);
    return 0;
}

int fs_log_write(const char *line)
{
    if (line == NULL) {
        return -EINVAL;
    }
    if (!fs_log_mounted) {
        return -ENOENT;
    }

    size_t len = strlen(line);
    bool need_newline = (len == 0) || (line[len - 1] != '\n');

    struct fs_file_t f;
    fs_file_t_init(&f);

    k_mutex_lock(&fs_log_mutex, K_FOREVER);

    int rc = fs_open(&f, FS_LOG_FILE_PATH, FS_O_CREATE | FS_O_WRITE | FS_O_APPEND);
    if (rc < 0) {
        k_mutex_unlock(&fs_log_mutex);
        return rc;
    }

    ssize_t written = 0;
    if (len > 0) {
        ssize_t w = fs_write(&f, line, len);
        if (w < 0) {
            (void)fs_close(&f);
            k_mutex_unlock(&fs_log_mutex);
            return (int)w;
        }
        written += w;
    }

    if (need_newline) {
        ssize_t w = fs_write(&f, "\n", 1);
        if (w < 0) {
            (void)fs_close(&f);
            k_mutex_unlock(&fs_log_mutex);
            return (int)w;
        }
        written += w;
    }

    /* fsync ensures data is flushed to flash even if we lose power. */
    (void)fs_sync(&f);
    (void)fs_close(&f);

    k_mutex_unlock(&fs_log_mutex);
    return (int)written;
}

int fs_log_writef(const char *fmt, ...)
{
    if (fmt == NULL) {
        return -EINVAL;
    }

    char buf[160];
    va_list ap;
    va_start(ap, fmt);
    int n = vsnprintf(buf, sizeof(buf), fmt, ap);
    va_end(ap);

    if (n < 0) {
        return -EINVAL;
    }
    /* Truncation is fine; buf is NUL-terminated either way. */
    return fs_log_write(buf);
}

int fs_log_read_all(fs_log_line_cb_t cb, void *user_data)
{
    if (cb == NULL) {
        return -EINVAL;
    }
    if (!fs_log_mounted) {
        return -ENOENT;
    }

    struct fs_file_t f;
    fs_file_t_init(&f);

    k_mutex_lock(&fs_log_mutex, K_FOREVER);

    int rc = fs_open(&f, FS_LOG_FILE_PATH, FS_O_READ);
    if (rc < 0) {
        k_mutex_unlock(&fs_log_mutex);
        return rc;
    }

    char chunk[128];
    char line[160];
    size_t line_len = 0;
    int line_count = 0;

    ssize_t r;
    while ((r = fs_read(&f, chunk, sizeof(chunk))) > 0) {
        for (ssize_t i = 0; i < r; i++) {
            char c = chunk[i];
            if (c == '\n' || line_len == sizeof(line) - 1) {
                line[line_len] = '\0';
                cb(line, user_data);
                line_count++;
                line_len = 0;
                if (c != '\n') {
                    /* Long line continuation - keep the char that didn't fit. */
                    line[line_len++] = c;
                }
            } else if (c != '\r') {
                line[line_len++] = c;
            }
        }
    }

    if (r < 0) {
        (void)fs_close(&f);
        k_mutex_unlock(&fs_log_mutex);
        return (int)r;
    }

    if (line_len > 0) {
        line[line_len] = '\0';
        cb(line, user_data);
        line_count++;
    }

    (void)fs_close(&f);
    k_mutex_unlock(&fs_log_mutex);
    return line_count;
}

int fs_log_clear(void)
{
    if (!fs_log_mounted) {
        return -ENOENT;
    }

    k_mutex_lock(&fs_log_mutex, K_FOREVER);

    /* Removing and re-creating gives us a zero-length file deterministically. */
    int rc = fs_unlink(FS_LOG_FILE_PATH);
    if (rc < 0 && rc != -ENOENT) {
        k_mutex_unlock(&fs_log_mutex);
        return rc;
    }
    rc = ensure_log_file();

    k_mutex_unlock(&fs_log_mutex);
    return rc;
}

int fs_log_stats(size_t *total_bytes, size_t *used_bytes)
{
    if (total_bytes == NULL || used_bytes == NULL) {
        return -EINVAL;
    }
    if (!fs_log_mounted) {
        return -ENOENT;
    }

    struct fs_statvfs st;
    int rc = fs_statvfs(fs_log_mnt.mnt_point, &st);
    if (rc < 0) {
        return rc;
    }

    *total_bytes = (size_t)(st.f_blocks * st.f_frsize);
    *used_bytes  = (size_t)((st.f_blocks - st.f_bfree) * st.f_frsize);
    return 0;
}

int fs_log_file_size(void)
{
    if (!fs_log_mounted) {
        return -ENOENT;
    }

    struct fs_dirent ent;
    int rc = fs_stat(FS_LOG_FILE_PATH, &ent);
    if (rc < 0) {
        return rc;
    }
    return (int)ent.size;
}

/* -------------------------------------------------------------------------- */
/* Shell commands: fslog write|read|clear|stats|size                          */
/* -------------------------------------------------------------------------- */

#include <zephyr/shell/shell.h>

static void shell_line_cb(const char *line, void *user_data)
{
    const struct shell *sh = (const struct shell *)user_data;
    shell_print(sh, "%s", line);
}

static int cmd_fslog_write(const struct shell *sh, size_t argc, char **argv)
{
    if (argc < 2) {
        shell_error(sh, "usage: fslog write <text...>");
        return -EINVAL;
    }

    /* Join argv[1..argc-1] with spaces. */
    char buf[160];
    size_t off = 0;
    for (size_t i = 1; i < argc; i++) {
        int n = snprintf(buf + off, sizeof(buf) - off, "%s%s",
                         (i > 1) ? " " : "", argv[i]);
        if (n < 0 || (size_t)n >= sizeof(buf) - off) {
            break;
        }
        off += n;
    }

    int rc = fs_log_write(buf);
    if (rc < 0) {
        shell_error(sh, "write failed: %d", rc);
        return rc;
    }
    shell_print(sh, "wrote %d bytes", rc);
    return 0;
}

static int cmd_fslog_read(const struct shell *sh, size_t argc, char **argv)
{
    ARG_UNUSED(argc);
    ARG_UNUSED(argv);

    int n = fs_log_read_all(shell_line_cb, (void *)sh);
    if (n < 0) {
        shell_error(sh, "read failed: %d", n);
        return n;
    }
    shell_print(sh, "(%d line%s)", n, n == 1 ? "" : "s");
    return 0;
}

static int cmd_fslog_clear(const struct shell *sh, size_t argc, char **argv)
{
    ARG_UNUSED(argc);
    ARG_UNUSED(argv);

    int rc = fs_log_clear();
    if (rc < 0) {
        shell_error(sh, "clear failed: %d", rc);
        return rc;
    }
    shell_print(sh, "log cleared");
    return 0;
}

static int cmd_fslog_stats(const struct shell *sh, size_t argc, char **argv)
{
    ARG_UNUSED(argc);
    ARG_UNUSED(argv);

    size_t total = 0, used = 0;
    int rc = fs_log_stats(&total, &used);
    if (rc < 0) {
        shell_error(sh, "stats failed: %d", rc);
        return rc;
    }

    int file_sz = fs_log_file_size();
    shell_print(sh, "mount:   %s", FS_LOG_MOUNT_POINT);
    shell_print(sh, "total:   %u bytes", (unsigned int)total);
    shell_print(sh, "used:    %u bytes", (unsigned int)used);
    shell_print(sh, "free:    %u bytes", (unsigned int)(total - used));
    if (file_sz >= 0) {
        shell_print(sh, "log:     %s (%d bytes)", FS_LOG_FILE_PATH, file_sz);
    } else {
        shell_print(sh, "log:     %s (stat err %d)", FS_LOG_FILE_PATH, file_sz);
    }
    return 0;
}

SHELL_STATIC_SUBCMD_SET_CREATE(
    fslog_sub,
    SHELL_CMD_ARG(write, NULL, "Append a line to the log",   cmd_fslog_write, 2, 16),
    SHELL_CMD(   read,  NULL, "Print the log",               cmd_fslog_read),
    SHELL_CMD(   clear, NULL, "Truncate the log",            cmd_fslog_clear),
    SHELL_CMD(   stats, NULL, "Show filesystem statistics",  cmd_fslog_stats),
    SHELL_SUBCMD_SET_END
);

SHELL_CMD_REGISTER(fslog, &fslog_sub, "LittleFS log commands", NULL);
```

## src/fs_log.h
```c
/*
 * fs_log.h - Simple append-only line logger backed by LittleFS.
 *
 * Provides a thin, thread-safe wrapper around Zephyr's file system API
 * to mount a LittleFS partition and read/write/clear log lines.
 */

#ifndef FS_LOG_H
#define FS_LOG_H

#include <stddef.h>
#include <stdint.h>

/* Mount point on the VFS. */
#define FS_LOG_MOUNT_POINT "/lfs"

/* Default log file (under the mount point). */
#define FS_LOG_FILE_PATH   FS_LOG_MOUNT_POINT "/log.txt"

/**
 * Mount the LittleFS partition and ensure the log file exists.
 *
 * @return 0 on success, negative errno on failure.
 */
int fs_log_init(void);

/**
 * Append a line of text to the log file. A newline is added automatically
 * if @p line does not already end with one.
 *
 * @param line NUL-terminated string to append.
 * @return Number of bytes written on success, negative errno on failure.
 */
int fs_log_write(const char *line);

/**
 * Append a formatted line (printf-style) to the log file.
 *
 * @return Number of bytes written on success, negative errno on failure.
 */
int fs_log_writef(const char *fmt, ...);

/**
 * Read the entire log file and invoke @p cb for each line (without newline).
 *
 * @param cb       Callback called per line; @p user_data is forwarded.
 * @param user_data Opaque pointer passed to @p cb.
 * @return Number of lines read on success, negative errno on failure.
 */
typedef void (*fs_log_line_cb_t)(const char *line, void *user_data);
int fs_log_read_all(fs_log_line_cb_t cb, void *user_data);

/**
 * Truncate the log file to zero length.
 *
 * @return 0 on success, negative errno on failure.
 */
int fs_log_clear(void);

/**
 * Get filesystem statistics for the mounted partition.
 *
 * @param[out] total_bytes Total bytes available on the partition.
 * @param[out] used_bytes  Bytes currently in use.
 * @return 0 on success, negative errno on failure.
 */
int fs_log_stats(size_t *total_bytes, size_t *used_bytes);

/**
 * Get the size in bytes of the log file.
 *
 * @return File size on success, negative errno on failure.
 */
int fs_log_file_size(void);

#endif /* FS_LOG_H */
```

## src/minheap.h
```c
#ifndef MINHEAP_H
#define MINHEAP_H

#include <stddef.h>

#define MAX_HEAP_SIZE 30
#define FLIGHT_NAME_MAX_LEN 16

struct HEAP_NODE {
    char flightName[FLIGHT_NAME_MAX_LEN];

    float longitude;
    float latitude;

    float loclong;
    float loclat;
};

void print_heap();

#define FLOAT_STR_LEN 12

struct HEAP_JSON {
    char *flightName[MAX_HEAP_SIZE];

    char longitudeStr[MAX_HEAP_SIZE][FLOAT_STR_LEN];
    char latitudeStr[MAX_HEAP_SIZE][FLOAT_STR_LEN];
    char loclongStr[MAX_HEAP_SIZE][FLOAT_STR_LEN];
    char loclatStr[MAX_HEAP_SIZE][FLOAT_STR_LEN];

    size_t heap_len;
};

int insert_into_heap(const char *flightName,
                     float longitude,
                     float latitude,
                     float loclong,
                     float loclat);

int convert_heap_to_string();

#endif /* MINHEAP_H */
```
