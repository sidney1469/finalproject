## CMakeLists.txt
```
cmake_minimum_required(VERSION 3.20.0)

find_package(Zephyr REQUIRED HINTS $ENV{ZEPHYR_BASE})
project(base)

set(LIB_DIR ${CMAKE_CURRENT_SOURCE_DIR}/../lib/src)

target_sources(app PRIVATE
  src/main.c
    src/minheap.c
    src/ble_central.c
    ${LIB_DIR}/protocol.c
)

target_include_directories(app PRIVATE
  src
  ${LIB_DIR}
  ${ZEPHYR_BASE}/samples/bluetooth
)
```

## prj.conf
```kconfig
CONFIG_BT=y
CONFIG_BT_CENTRAL=y
CONFIG_BT_GATT_CLIENT=y
CONFIG_GPIO=y
CONFIG_BT_MAX_CONN=2
CONFIG_BT_MAX_PAIRED=2
CONFIG_BT_BUF_ACL_RX_SIZE=251
CONFIG_BT_BUF_ACL_TX_SIZE=251
CONFIG_BT_L2CAP_TX_MTU=247
CONFIG_BT_CTLR_DATA_LENGTH_MAX=251

CONFIG_THREAD_NAME=y
CONFIG_THREAD_MONITOR=y
CONFIG_MAIN_STACK_SIZE=2048
CONFIG_SYSTEM_WORKQUEUE_STACK_SIZE=2048
CONFIG_SYSTEM_WORKQUEUE_STACK_SIZE=4096
CONFIG_JSON_LIBRARY=y
CONFIG_JSON_LIBRARY_FP_SUPPORT=y
CONFIG_MIN_HEAP=y


CONFIG_BT=y
CONFIG_BT_CENTRAL=y
CONFIG_BT_GATT_CLIENT=y
CONFIG_BT_ZEPHYR_NUS=y
CONFIG_JSON_LIBRARY=y
CONFIG_SHELL=y
CONFIG_SHELL_BACKEND_SERIAL=y
CONFIG_UART_CONSOLE=y
CONFIG_FPU=y
CONFIG_FPU_SHARING=y
CONFIG_CBPRINTF_FP_SUPPORT=y
CONFIG_MIN_HEAP=y

CONFIG_HEAP_MEM_POOL_SIZE=4096
CONFIG_USB_CDC_ACM_RINGBUF_SIZE=4096
CONFIG_SHELL_BACKEND_SERIAL_TX_RING_BUFFER_SIZE=4096
CONFIG_CBPRINTF_FP_SUPPORT=y
```

## src/main.c
```c
#include <string.h>
#include <zephyr/kernel.h>
#include <zephyr/sys/printk.h>
#include "ble_central.h"
#include "protocol.h"
#include "minheap.h"
#include <zephyr/data/json.h>

#define ACTUATOR_ADDR "C1:C4:D7:FA:FB:15" // Sidney's
#define SENSOR_ADDR                                                                                \
    "E9:83:9E:1B:4B:0F" // Xander's
                        // "C5:9A:5F:B3:A9:65" // Fiachra's

#define CONTROL_STACK_SIZE 2048
#define RECEIVER_STACK_SIZE 4096
#define SENDER_STACK_SIZE   2048

K_THREAD_STACK_DEFINE(control_stack_area, CONTROL_STACK_SIZE);
K_THREAD_STACK_DEFINE(receiver_stack_area, RECEIVER_STACK_SIZE);
K_THREAD_STACK_DEFINE(sender_stack_area, SENDER_STACK_SIZE);

#define CONTROL_PRIORITY 9
#define RECEIVER_PRIORITY 5
#define SENDER_PRIORITY 7

struct k_thread control_thread_data;
struct k_thread receiver_thread_data;
struct k_thread sender_thread_data;

struct bt_data_received {
    size_t data_len;
    uint8_t data_buffer[256];
};

K_MSGQ_DEFINE(sensor_msgq, sizeof(struct bt_data_received), 10, 4);

void my_receive_callback(const void *data, uint16_t len)
{
    printk("callback called, len=%d\n", len);  // add this
    struct bt_data_received msg;
    msg.data_len = len;
    memcpy(msg.data_buffer, data, len);
    k_msgq_put(&sensor_msgq, &msg, K_NO_WAIT);
  
  
    sensor_message_t received_data;
    char buf[len + 1];
    memcpy(buf, data, len);
    buf[len] = '\0';
    printk("%s\n", buf);
    int64_t parsed = json_obj_parse(buf, len, sensor_message_descr,
                                sensor_message_descr_len, &received_data);

    if (parsed < 0) {
        printk("json parse failed: %lld\n", parsed);
        return;
    }

    /* Optional: require that top-level "plane" object decoded (bit1) */
    if ((parsed & 0x2) == 0) {
        printk("No plane object in JSON\n");
        return;
    }

    /* Semantic guard: plane present but empty/default payload */
    if (received_data.plane.icao[0] == '\0' ||
        received_data.plane.ts[0] == '\0') {
        printk("No active plane data, skipping heap insert\n");
        return;
    }

    int rc = insert_into_heap(received_data.gps, received_data.plane);

    if (rc) {
        printk("insert_into_heap failed: %d\n", rc);
        return;
    }
    convert_heap_to_string();
}

void init_bluetooth(void)
{
    ble_add(SENSOR_ADDR, my_receive_callback, false);
    ble_add(ACTUATOR_ADDR, NULL, true);

    int err = ble_start();
    if (err) {
        printk("BLE client start failed (err %d)\n", err);
        return;
    }

    printk("BLE client started\n");
    return;
}

void control_thread(void *a, void *b, void *c)
{
    while (1) {
        k_sleep(K_FOREVER);
    }
}

void receiver_thread(void *a, void *b, void *c)
{
    printk("Receiver thread started\n");
    struct bt_data_received msg;

    while (1) {
        k_msgq_get(&sensor_msgq, &msg, K_FOREVER);
        char buf[257];
        memcpy(buf, msg.data_buffer, msg.data_len);
        buf[msg.data_len] = '\0';
        printk("%s\n", buf);
    }
}

void sender_thread(void *a, void *b, void *c)
{
    while (1) {
        k_sleep(K_SECONDS(1));
        int err = ble_send(ACTUATOR_ADDR, "hello", strlen("hello"));
        if (err == -ENODEV) {
            printk("Sender not ready yet\n");
        } else if (err) {
            printk("Send failed (err %d)\n", err);
        } else {
            printk("Sent: hello\n");
        }
    }
}

int main(void)
{
    init_bluetooth();

    k_tid_t control_tid = k_thread_create(&control_thread_data, control_stack_area,
                                  K_THREAD_STACK_SIZEOF(control_stack_area), control_thread, NULL,
                                  NULL, NULL, CONTROL_PRIORITY, 0, K_NO_WAIT);

    if (!control_tid) {
        printk("Failed to create control thread!\n");
    }

    k_tid_t receiver_tid = k_thread_create(&receiver_thread_data, receiver_stack_area,
                                  K_THREAD_STACK_SIZEOF(receiver_stack_area), receiver_thread, NULL,
                                  NULL, NULL, RECEIVER_PRIORITY, 0, K_NO_WAIT);

    if (!receiver_tid) {
        printk("Failed to create receiver thread!\n");
    }

    k_tid_t sender_tid = k_thread_create(&sender_thread_data, sender_stack_area,
                                  K_THREAD_STACK_SIZEOF(sender_stack_area), sender_thread, NULL,
                                  NULL, NULL, SENDER_PRIORITY, 0, K_NO_WAIT);

    if (!sender_tid) {
        printk("Failed to create sender thread!\n");
    }

    while(1) {
        k_sleep(K_FOREVER);
    }

    return 0;
}
```

## src/ble_central.c
```c
#include <stddef.h>
#include <stdio.h>
#include <errno.h>
#include <stdlib.h>

#include <zephyr/kernel.h>
#include <zephyr/sys/printk.h>
#include <zephyr/bluetooth/bluetooth.h>
#include <zephyr/bluetooth/hci.h>
#include <zephyr/bluetooth/conn.h>
#include <zephyr/bluetooth/uuid.h>
#include <zephyr/bluetooth/gatt.h>
#include <zephyr/bluetooth/services/nus.h>
#include <zephyr/sys/byteorder.h>
#include <zephyr/types.h>
#include <zephyr/sys/uuid.h>

#include "ble_central.h"

#define MAX_CONNECTIONS 2

typedef void (*nus_data_cb_t)(const void *data, uint16_t len);

typedef struct {
    bt_addr_le_t target_addr;
    struct bt_conn *conn;
    struct bt_uuid_128 discover_uuid;
    struct bt_uuid_16 discover_ccc_uuid;
    struct bt_gatt_discover_params discover_params;
    struct bt_gatt_subscribe_params subscribe_params;
    struct bt_gatt_exchange_params mtu_params;
    nus_data_cb_t data_cb;
    bool in_use;
} ble_ctx_t;

static ble_ctx_t clients[MAX_CONNECTIONS];
static uint8_t volatile conn_count;

/* Nordic UART Service UUIDs */
static struct bt_uuid_128 nus_svc_uuid = BT_UUID_INIT_128(BT_UUID_NUS_SRV_VAL);
static struct bt_uuid_128 nus_tx_uuid = BT_UUID_INIT_128(BT_UUID_NUS_TX_CHAR_VAL);
static struct bt_uuid_128 nus_rx_uuid = BT_UUID_INIT_128(BT_UUID_NUS_RX_CHAR_VAL);

static void start_scan(void);

static void device_found(const bt_addr_le_t *addr, int8_t rssi, uint8_t type,
                         struct net_buf_simple *ad)
{
    char addr_str[BT_ADDR_LE_STR_LEN];
    int err;

    if (type != BT_GAP_ADV_TYPE_ADV_IND && type != BT_GAP_ADV_TYPE_ADV_DIRECT_IND) {
        return;
    }

    bt_addr_le_to_str(addr, addr_str, sizeof(addr_str));

    /* check if this address matches any registered client slot */
    ble_ctx_t *ctx = NULL;
    for (int i = 0; i < MAX_CONNECTIONS; i++) {
        if (clients[i].in_use && clients[i].conn == NULL) {
            char target_str[BT_ADDR_LE_STR_LEN];
            bt_addr_le_to_str(&clients[i].target_addr, target_str, sizeof(target_str));
            if (strncmp(addr_str, target_str, strlen(target_str)) == 0) {
                ctx = &clients[i];
                break;
            }
        }
    }

    if (!ctx) {
        return;
    }

    if (bt_le_scan_stop()) {
        return;
    }

    err = bt_conn_le_create(addr, BT_CONN_LE_CREATE_CONN, BT_LE_CONN_PARAM_DEFAULT, &ctx->conn);
    if (err) {
        printk("Create conn to %s failed (%d)\n", addr_str, err);
        start_scan();
    }
}

static uint8_t notify_func(struct bt_conn *conn, struct bt_gatt_subscribe_params *params,
                           const void *data, uint16_t length)
{
    ble_ctx_t *ctx = CONTAINER_OF(params, ble_ctx_t, subscribe_params);

    if (!data) {
        printk("[UNSUBSCRIBED]\n");
        params->value_handle = 0U;
        return BT_GATT_ITER_STOP;
    }

    if (ctx->data_cb) {
        ctx->data_cb(data, length);
    }

    return BT_GATT_ITER_CONTINUE;
}

static uint8_t discover_func(struct bt_conn *conn, const struct bt_gatt_attr *attr,
                             struct bt_gatt_discover_params *params)
{
    ble_ctx_t *ctx = CONTAINER_OF(params, ble_ctx_t, discover_params);

    int err;

    if (!attr) {
        printk("Discover complete\n");
        (void)memset(params, 0, sizeof(*params));
        return BT_GATT_ITER_STOP;
    }

    if (!bt_uuid_cmp(ctx->discover_params.uuid, &nus_svc_uuid.uuid)) {

        // found NUS; find the tx characteristic
        memcpy(&ctx->discover_uuid, &nus_tx_uuid.uuid, sizeof(ctx->discover_uuid));
        ctx->discover_params.uuid = &ctx->discover_uuid.uuid;
        ctx->discover_params.start_handle = attr->handle + 1;
        ctx->discover_params.type = BT_GATT_DISCOVER_CHARACTERISTIC;

        err = bt_gatt_discover(conn, &ctx->discover_params);
        if (err) {
            printk("Discover failed (err %d)\n", err);
        }
    } else if (!bt_uuid_cmp(ctx->discover_params.uuid, &nus_tx_uuid.uuid)) {
        // found TX; find CCC
        memcpy(&ctx->discover_ccc_uuid.uuid, BT_UUID_GATT_CCC, sizeof(ctx->discover_ccc_uuid));
        ctx->discover_params.uuid = &ctx->discover_ccc_uuid.uuid;
        ctx->discover_params.start_handle = attr->handle + 2;
        ctx->discover_params.type = BT_GATT_DISCOVER_DESCRIPTOR;
        ctx->subscribe_params.value_handle = bt_gatt_attr_value_handle(attr);

        err = bt_gatt_discover(conn, &ctx->discover_params);
        if (err) {
            printk("Discover failed (err %d)\n", err);
        }
    } else {
        ctx->subscribe_params.notify = notify_func;
        ctx->subscribe_params.value = BT_GATT_CCC_NOTIFY;
        ctx->subscribe_params.ccc_handle = attr->handle;

        err = bt_gatt_subscribe(conn, &ctx->subscribe_params);
        if (err && err != -EALREADY) {
            printk("Subscribe failed (err %d)\n", err);
        } else {
            printk("[SUBSCRIBED]\n");
        }

        return BT_GATT_ITER_STOP;
    }

    return BT_GATT_ITER_STOP;
}

static void start_scan(void)
{
    int err;
    err = bt_le_scan_start(BT_LE_SCAN_PASSIVE, device_found);
    if (err) {
        printk("Scanning failed to start (err %d)\n", err);
        return;
    }
}

static ble_ctx_t *get_ctx_by_conn(struct bt_conn *conn)
{
    for (int i = 0; i < MAX_CONNECTIONS; i++) {
        if (clients[i].conn == conn) {
            return &clients[i];
        }
    }
    return NULL;
}

static void mtu_exchange_cb(struct bt_conn *conn, uint8_t err,
                            struct bt_gatt_exchange_params *params)
{
    printk("MTU exchange %s (%u)\n", err == 0U ? "successful" : "failed", bt_gatt_get_mtu(conn));
}

static int mtu_exchange(struct bt_conn *conn, ble_ctx_t *ctx)
{

    ctx->mtu_params.func = mtu_exchange_cb;
    int err = bt_gatt_exchange_mtu(conn, &ctx->mtu_params);

    if (err) {
        printk("MTU exchange failed (err %d)\n", err);
    }

    return err;
}

static void connected(struct bt_conn *conn, uint8_t err)
{
    char addr[BT_ADDR_LE_STR_LEN];
    bt_addr_le_to_str(bt_conn_get_dst(conn), addr, sizeof(addr));

    ble_ctx_t *ctx = get_ctx_by_conn(conn);
    if (!ctx) {
        return;
    }

    if (err) {
        printk("Failed to connect to %s %u %s\n", addr, err, bt_hci_err_to_str(err));
        bt_conn_unref(ctx->conn);
        ctx->conn = NULL;
        start_scan();
        return;
    }

    printk("Connected: %s\n", addr);
    conn_count++;

    mtu_exchange(conn, ctx);

    memcpy(&ctx->discover_uuid, BT_UUID_NUS_SERVICE, sizeof(ctx->discover_uuid));
    ctx->discover_params.uuid = &ctx->discover_uuid.uuid;
    ctx->discover_params.func = discover_func;
    ctx->discover_params.start_handle = BT_ATT_FIRST_ATTRIBUTE_HANDLE;
    ctx->discover_params.end_handle = BT_ATT_LAST_ATTRIBUTE_HANDLE;
    ctx->discover_params.type = BT_GATT_DISCOVER_PRIMARY;

    err = bt_gatt_discover(conn, &ctx->discover_params);
    if (err) {
        printk("Discover failed(err %d)\n", err);
        return;
    }

    if (conn_count < MAX_CONNECTIONS) {
        start_scan();
    }
}

static void disconnected(struct bt_conn *conn, uint8_t reason)
{
    char addr[BT_ADDR_LE_STR_LEN];
    bt_addr_le_to_str(bt_conn_get_dst(conn), addr, sizeof(addr));
    ble_ctx_t *ctx = get_ctx_by_conn(conn);

    if (!ctx) {
        return;
    }

    printk("Disconnected: %s, reason 0x%02x %s\n", addr, reason, bt_hci_err_to_str(reason));

    bt_conn_unref(ctx->conn);
    ctx->conn = NULL;
    conn_count--;

    start_scan();
}

BT_CONN_CB_DEFINE(conn_callbacks) = {
    .connected = connected,
    .disconnected = disconnected,
};

int ble_add(const char *addr_str, nus_data_cb_t cb)
{
    for (int i = 0; i < MAX_CONNECTIONS; i++) {
        if (!clients[i].in_use) {
            bt_addr_le_from_str(addr_str, "random", &clients[i].target_addr);
            clients[i].data_cb = cb;
            clients[i].in_use = true;
            clients[i].conn = NULL;
            return 0;
        }
    }
    return -ENOMEM;
}

int ble_start(void)
{
    int err = bt_enable(NULL);
    if (err) {
        printk("Bluetooth init failed (err %d)\n", err);
        return err;
    }

    printk("Bluetooth initialized\n");
    start_scan();
    return 0;
}
```

## src/ble_central.h
```c
#ifndef BLE_CLIENT_H
#define BLE_CLIENT_H

#include <stdint.h>

typedef void (*nus_data_cb_t)(const void *data, uint16_t len);

int ble_add(const char *addr_str, nus_data_cb_t cb);
int ble_start(void);

#endif
```

## src/ble_client.c
```c
#include <stddef.h>
#include <stdio.h>
#include <errno.h>
#include <stdlib.h>

#include <zephyr/kernel.h>
#include <zephyr/sys/printk.h>
#include <zephyr/bluetooth/bluetooth.h>
#include <zephyr/bluetooth/hci.h>
#include <zephyr/bluetooth/conn.h>
#include <zephyr/bluetooth/uuid.h>
#include <zephyr/bluetooth/gatt.h>
#include <zephyr/sys/byteorder.h>
#include <zephyr/types.h>
#include <zephyr/sys/uuid.h>

#include "ble_client.h"

static void start_scan(void);

static struct bt_conn *default_conn;

// define the addresses of the possible mobile nodes
#define MOBILE_NODE_ADDR_MAL	"F4:4A:CE:71:27:25"
#define MOBILE_NODE_ADDR_XANDER "E9:83:9E:1B:4B:0F"
#define MOBILE_NODE_ADDR_DK 	"DC:56:43:F9:59:37"

/* Nordic UART Service UUID: 6E400001-B5A3-F393-E0A9-E50E24DCCA9E */
#define BT_UUID_NUS_SERVICE_VAL \
    BT_UUID_128_ENCODE(0x6e400001, 0xb5a3, 0xf393, 0xe0a9, 0xe50e24dcca9e)
#define BT_UUID_NUS_SERVICE \
    BT_UUID_DECLARE_128(BT_UUID_NUS_SERVICE_VAL)

/* Nordic UART TX Characteristic (Central receives notifications from this): 6E400003... */
#define BT_UUID_NUS_TX_VAL \
    BT_UUID_128_ENCODE(0x6e400003, 0xb5a3, 0xf393, 0xe0a9, 0xe50e24dcca9e)
#define BT_UUID_NUS_TX \
    BT_UUID_DECLARE_128(BT_UUID_NUS_TX_VAL)

// empty structs for later discovery and subscription
static struct bt_uuid_128 discover_uuid = BT_UUID_INIT_128(0);
static struct bt_uuid_16 discover_ccc_uuid = BT_UUID_INIT_16(0);

static struct bt_gatt_discover_params discover_params;
static struct bt_gatt_subscribe_params subscribe_params;

static void device_found(const bt_addr_le_t *addr, int8_t rssi, uint8_t type,
             struct net_buf_simple *ad)
{
    char addr_str[BT_ADDR_LE_STR_LEN];
    int err;

    bt_addr_le_to_str(addr, addr_str, sizeof(addr_str));

    if (default_conn) {
        return;
    }

    /* We're only interested in connectable events */
    if (type != BT_GAP_ADV_TYPE_ADV_IND &&
        type != BT_GAP_ADV_TYPE_ADV_DIRECT_IND) {
        return;
    }

    if (
        strncmp(addr_str, MOBILE_NODE_ADDR_XANDER, strlen(MOBILE_NODE_ADDR_XANDER)) &&
        strncmp(addr_str, MOBILE_NODE_ADDR_DK, strlen(MOBILE_NODE_ADDR_DK)) &&
        strncmp(addr_str, MOBILE_NODE_ADDR_MAL, strlen(MOBILE_NODE_ADDR_MAL))
    ) {
        return;
    }

    if (bt_le_scan_stop()) {
        return;
    }

    err = bt_conn_le_create(addr, BT_CONN_LE_CREATE_CONN,
                BT_LE_CONN_PARAM_DEFAULT, &default_conn);
    if (err) {
        printk("Create conn to %s failed (%d)\n", addr_str, err);
        start_scan();
    }
}

static uint8_t notify_func(struct bt_conn *conn,
               struct bt_gatt_subscribe_params *params,
               const void *data, uint16_t length)
{
    if (!data) {
        printk("[UNSUBSCRIBED]\n");
        params->value_handle = 0U;
        return BT_GATT_ITER_STOP;
    }

    char data_string[length + 1];
    memcpy(data_string, data, length);
    data_string[length] = '\0';

    printk("%s\n", data_string);

    return BT_GATT_ITER_CONTINUE;
}

static uint8_t discover_func(struct bt_conn *conn,
                 const struct bt_gatt_attr *attr,
                 struct bt_gatt_discover_params *params)
{
    int err;

    if (!attr) {
        printk("Discover complete\n");
        (void)memset(params, 0, sizeof(*params));
        return BT_GATT_ITER_STOP;
    }

    if (!bt_uuid_cmp(discover_params.uuid, BT_UUID_NUS_SERVICE)) {
        // found NUS; find the tx characteristic
        memcpy(&discover_uuid, BT_UUID_NUS_TX, sizeof(discover_uuid));
        discover_params.uuid = &discover_uuid.uuid;
        discover_params.start_handle = attr->handle + 1;
        discover_params.type = BT_GATT_DISCOVER_CHARACTERISTIC;

        err = bt_gatt_discover(conn, &discover_params);
        if (err) {
            printk("Discover failed (err %d)\n", err);
        }
    } else if (!bt_uuid_cmp(discover_params.uuid,
                BT_UUID_NUS_TX)) {
        // found TX; find CCC
        memcpy(&discover_ccc_uuid.uuid, BT_UUID_GATT_CCC, sizeof(discover_ccc_uuid));
        discover_params.uuid = &discover_ccc_uuid.uuid;
        discover_params.start_handle = attr->handle + 2;
        discover_params.type = BT_GATT_DISCOVER_DESCRIPTOR;
        subscribe_params.value_handle = bt_gatt_attr_value_handle(attr);

        err = bt_gatt_discover(conn, &discover_params);
        if (err) {
            printk("Discover failed (err %d)\n", err);
        }
    } else {
        subscribe_params.notify = notify_func;
        subscribe_params.value = BT_GATT_CCC_NOTIFY; // NUS uses noti's
        subscribe_params.ccc_handle = attr->handle;

        err = bt_gatt_subscribe(conn, &subscribe_params);
        if (err && err != -EALREADY) {
            printk("Subscribe failed (err %d)\n", err);
        } else {
            printk("[SUBSCRIBED]\n");
        }

        return BT_GATT_ITER_STOP;
    }

    return BT_GATT_ITER_STOP;
}

static void start_scan(void)
{
    int err;
    err = bt_le_scan_start(BT_LE_SCAN_PASSIVE, device_found);
    if (err) {
        printk("Scanning failed to start (err %d)\n", err);
        return;
    }
}

static void mtu_exchange_cb(struct bt_conn *conn, uint8_t err,
                struct bt_gatt_exchange_params *params)
{
    printk("%s: MTU exchange %s (%u)\n", __func__,
           err == 0U ? "successful" : "failed",
           bt_gatt_get_mtu(conn));
}

static struct bt_gatt_exchange_params mtu_exchange_params = {
    .func = mtu_exchange_cb
};

static int mtu_exchange(struct bt_conn *conn)
{
    int err;

    printk("%s: Current MTU = %u\n", __func__, bt_gatt_get_mtu(conn));

    printk("%s: Exchange MTU...\n", __func__);
    err = bt_gatt_exchange_mtu(conn, &mtu_exchange_params);
    if (err) {
        printk("%s: MTU exchange failed (err %d)", __func__, err);
    }

    return err;
}

static void connected(struct bt_conn *conn, uint8_t err)
{
    char addr[BT_ADDR_LE_STR_LEN];

    bt_addr_le_to_str(bt_conn_get_dst(conn), addr, sizeof(addr));

    if (err) {
        printk("Failed to connect to %s %u %s\n", addr, err,
                bt_hci_err_to_str(err));

        bt_conn_unref(default_conn);
        default_conn = NULL;

        start_scan();
        return;
    }

    if (conn != default_conn) {
        return;
    }

    printk("Connected: %s\n", addr);

    // exchange mtu info to increase uart send size
    (void)mtu_exchange(conn);

    // find the service and hand off to discover_func
    if (conn == default_conn) {
        memcpy(&discover_uuid, BT_UUID_NUS_SERVICE, sizeof(discover_uuid));
        discover_params.uuid = &discover_uuid.uuid;
        discover_params.func = discover_func;
        discover_params.start_handle = BT_ATT_FIRST_ATTRIBUTE_HANDLE;
        discover_params.end_handle = BT_ATT_LAST_ATTRIBUTE_HANDLE;
        discover_params.type = BT_GATT_DISCOVER_PRIMARY;

        err = bt_gatt_discover(default_conn, &discover_params);
        if (err) {
            printk("Discover failed(err %d)\n", err);
            return;
        }
    }

}

static void disconnected(struct bt_conn *conn, uint8_t reason)
{
    char addr[BT_ADDR_LE_STR_LEN];

    if (conn != default_conn) {
        return;
    }

    bt_addr_le_to_str(bt_conn_get_dst(conn), addr, sizeof(addr));

    printk("Disconnected: %s, reason 0x%02x %s\n", addr, reason, bt_hci_err_to_str(reason));

    bt_conn_unref(default_conn);
    default_conn = NULL;

    start_scan();
}

BT_CONN_CB_DEFINE(conn_callbacks) = {
    .connected = connected,
    .disconnected = disconnected,
};

int ble_client_start(void)
{
    int err = bt_enable(NULL);
    if (err) {
        printk("Bluetooth init failed (err %d)\n", err);
        return err;
    }

    printk("Bluetooth initialized\n");
    start_scan();
    return 0;
}
```

## src/ble_receive.c
```c
// "E9:E8:9E:1B:4B:0F"

#include <zephyr/types.h>
#include <stddef.h>
#include <zephyr/kernel.h>
#include <zephyr/sys/printk.h>
#include <zephyr/bluetooth/bluetooth.h>
#include <zephyr/bluetooth/hci.h>
#include <zephyr/bluetooth/conn.h>
#include <zephyr/bluetooth/uuid.h>
#include <zephyr/bluetooth/gatt.h>
#include <zephyr/bluetooth/services/nus.h>
#include <zephyr/sys/byteorder.h>

#include "ble_receive.h"

/* Target peripheral MAC addresses */
static const bt_addr_t target_mac = {.val = {0xE9, 0xE8, 0x9E, 0x1B, 0x4B, 0x0F}};

/* Active BLE connection used by the central device */
static struct bt_conn *default_conn;

/* Message queue for passing received Bluetooth data to main thread */
K_MSGQ_DEFINE(bt_data_msgq, sizeof(struct bt_data_received), 10, 4);

/* Nordic UART Service UUIDs */
static struct bt_uuid_128 nus_svc_uuid = BT_UUID_INIT_128(BT_UUID_NUS_SRV_VAL);
static struct bt_uuid_128 nus_tx_uuid = BT_UUID_INIT_128(BT_UUID_NUS_TX_CHAR_VAL);
static struct bt_uuid_128 nus_rx_uuid = BT_UUID_INIT_128(BT_UUID_NUS_RX_CHAR_VAL);

static struct bt_gatt_subscribe_params subscribe_params;
static struct bt_gatt_discover_params discover_params;

static void start_scan(void);

/*
 * Handles incoming NUS TX notifications.
 * Received data is copied into a queue so another thread can process it.
 */
static uint8_t on_received(struct bt_conn *conn, struct bt_gatt_subscribe_params *params,
                           const void *data, uint16_t length)
{
    if (!data) {
        printk("NUS TX unsubscribed\n");
        params->value_handle = 0;
        return BT_GATT_ITER_STOP;
    }

    const int8_t *bytes = (const uint8_t *)data;

    struct bt_data_received new_data = {0};
    uint16_t c = 0;

    for (int i = 0; i < length; i++) {
        new_data.data_buffer[i] = (int8_t)bytes[i];
        c++;
    }

    new_data.data_len = c;

    printk("RX [%d bytes]: ", length);
    for (int i = 0; i < length; i++) {
        printk("%c", bytes[i]);
    }
    printk("\n");

    k_msgq_put(&bt_data_msgq, &new_data, K_NO_WAIT);

    return BT_GATT_ITER_CONTINUE;
}
/*
 * Performs GATT discovery for the Nordic UART Service.
 * Once the TX characteristic is found, notifications are enabled.
 */
static uint8_t discover_func(struct bt_conn *conn, const struct bt_gatt_attr *attr,
                             struct bt_gatt_discover_params *params)
{
    if (!attr) {
        printk("Discovery complete\n");
        return BT_GATT_ITER_STOP;
    }

    if (!bt_uuid_cmp(params->uuid, &nus_svc_uuid.uuid)) {
        params->uuid = NULL; // Discover all characteristics
        params->start_handle = attr->handle + 1;
        params->type = BT_GATT_DISCOVER_CHARACTERISTIC;
        bt_gatt_discover(conn, params);
        return BT_GATT_ITER_STOP;
    }

    struct bt_gatt_chrc *chrc = (struct bt_gatt_chrc *)attr->user_data;

    if (!bt_uuid_cmp(chrc->uuid, &nus_tx_uuid.uuid)) {
        printk("Found NUS TX Characteristic\n");

        subscribe_params.notify = on_received;
        subscribe_params.value = BT_GATT_CCC_NOTIFY;
        subscribe_params.value_handle = chrc->value_handle;
        subscribe_params.ccc_handle = chrc->value_handle + 1;

        int err = bt_gatt_subscribe(conn, &subscribe_params);
        if (err) {
            printk("Subscribe failed: %d\n", err);
        } else {
            printk("Subscribed to NUS TX\n");
        }
    }

    else if (!bt_uuid_cmp(chrc->uuid, &nus_rx_uuid.uuid)) {
        printk("Found NUS RX Characteristic (Phone can write to this)\n");
    }

    return BT_GATT_ITER_CONTINUE;
}

/* Starts service discovery on the connected peripheral */
static void start_discovery(struct bt_conn *conn)
{
    discover_params.uuid = &nus_svc_uuid.uuid;
    discover_params.func = discover_func;
    discover_params.start_handle = BT_ATT_FIRST_ATTRIBUTE_HANDLE;
    discover_params.end_handle = BT_ATT_LAST_ATTRIBUTE_HANDLE;
    discover_params.type = BT_GATT_DISCOVER_PRIMARY;

    int err = bt_gatt_discover(conn, &discover_params);
    if (err) {
        printk("Discovery failed to start: %d\n", err);
    }
}

static void device_found(const bt_addr_le_t *addr, int8_t rssi, uint8_t type,
			 struct net_buf_simple *ad)
{
	char addr_str[BT_ADDR_LE_STR_LEN];
	int err;

	if (default_conn) {
		return;
	}

	/* We're only interested in connectable events */
	if (type != BT_GAP_ADV_TYPE_ADV_IND && type != BT_GAP_ADV_TYPE_ADV_DIRECT_IND) {
		return;
    }
    if (bt_addr_cmp(&addr->a, &target_mac) != 0) {
        return;
    }


	bt_addr_le_to_str(addr, addr_str, sizeof(addr_str));
	printk("Device found: %s\n", addr_str);

	if (bt_le_scan_stop()) {
		return;
	}

	err = bt_conn_le_create(addr, BT_CONN_LE_CREATE_CONN,
				BT_LE_CONN_PARAM_DEFAULT, &default_conn);
	if (err) {
		printk("Create conn to %s failed (%d)\n", addr_str, err);
		start_scan();
	}
}

/* Starts passive BLE scanning in central mode */
static void start_scan(void)
{
    int err = bt_le_scan_start(BT_LE_SCAN_PASSIVE, device_found);
    if (err) {
        printk("Scanning failed to start: %d\n", err);
        return;
    }

    printk("Scanning started\n");
}

static void connected(struct bt_conn *conn, uint8_t err)
{
	char addr[BT_ADDR_LE_STR_LEN];

	bt_addr_le_to_str(bt_conn_get_dst(conn), addr, sizeof(addr));

	if (err) {
		printk("Failed to connect to %s %u %s\n", addr, err, bt_hci_err_to_str(err));

		bt_conn_unref(default_conn);
		default_conn = NULL;

		start_scan();
		return;
	}

	if (conn != default_conn) {
		return;
	}

	printk("Connected: %s\n", addr);

	start_discovery(conn);
}

static void disconnected(struct bt_conn *conn, uint8_t reason)
{
	char addr[BT_ADDR_LE_STR_LEN];

	if (conn != default_conn) {
		return;
	}

	bt_addr_le_to_str(bt_conn_get_dst(conn), addr, sizeof(addr));

	printk("Disconnected: %s, reason 0x%02x %s\n", addr, reason, bt_hci_err_to_str(reason));

	bt_conn_unref(default_conn);
	default_conn = NULL;

	start_scan();
}

BT_CONN_CB_DEFINE(conn_callbacks) = {
	.connected = connected,
	.disconnected = disconnected,
};

void ble_receive_thread(void *a, void *b, void *c)
{
    int err = bt_enable(NULL);
    if (err) {
        printk("Bluetooth init failed: %d\n", err);
        return;
    }

    printk("Bluetooth initialized\n");
    start_scan();

    while (1) {
        k_sleep(K_FOREVER);
    }
}
```

## src/ble_receive.h
```c
#ifndef BLE_TRANSFER_H
#define BLE_TRANSFER_H

#include <stddef.h>
#include <zephyr/kernel.h>

#define NUS_MAX_DATA_LEN 64

struct bt_data_received {
    size_t data_len;
    int8_t data_buffer[NUS_MAX_DATA_LEN];
};

extern struct k_msgq bt_data_msgq;

void ble_receive_thread(void *a, void *b, void *c);

#endif /* BLE_TRANSFER_H */
```

## src/minheap.c
```c
#include "minheap.h"

#include <zephyr/kernel.h>
#include <zephyr/sys/min_heap.h>
#include <zephyr/data/json.h>
#include <zephyr/sys/util.h>
#include <zephyr/shell/shell.h>

#include <errno.h>
#include <stdbool.h>
#include <string.h>

/*
 * Returns the squared Euclidean distance between a plane's position and the
 * observer location in (longitude, latitude) space. Note: this is a flat-earth
 * approximation suitable for small geographic areas only; degree units are not
 * isotropic at non-zero latitudes.
 */
static float heap_node_distance_squared(const struct HEAP_NODE *node)
{
    float dx = node->plane_data.lon - node->gps_data.lon;
    float dy = node->plane_data.lat - node->gps_data.lat;

    return (dx * dx) + (dy * dy);
}

static int compare_heap_nodes(const void *a, const void *b)
{
    const struct HEAP_NODE *da = a;
    const struct HEAP_NODE *db = b;

    float difa = heap_node_distance_squared(da);
    float difb = heap_node_distance_squared(db);

    if (difa < difb) {
        return -1;
    }

    if (difa > difb) {
        return 1;
    }

    return 0;
}

static bool match_flight_name(const void *a, const void *b)
{
    const struct HEAP_NODE *node = a;
    const char *flightName = b;

    if (flightName == NULL) {
        return false;
    }

    return strcmp(node->plane_data.icao, flightName) == 0;
}

MIN_HEAP_DEFINE_STATIC(planeheap,
               MAX_HEAP_SIZE,
               sizeof(struct HEAP_NODE),
               __alignof__(struct HEAP_NODE),
               compare_heap_nodes);

               
int insert_into_heap(gps_location_t gps_data, airplane_t plane_data)
{
    struct HEAP_NODE node = {0};
    struct HEAP_NODE deletednode = {0};
    size_t index;

    node.gps_data = gps_data;
    node.plane_data = plane_data;

    int ret = min_heap_push(&planeheap, &node);

    if (ret != 0) {
        printk("insert_into_heap: failed to push %s: %d\n", plane_data.icao, ret);
        return ret;
    }

    return 0;
}

int convert_heap_to_string()
{

    void *elem;
    size_t index = 0;
    size_t newindex = 0;
    struct HEAP_NODE deletednode = {0};


    printk("[");

    MIN_HEAP_FOREACH(&planeheap, elem) {
        struct HEAP_NODE *d = elem;

        printk("%s{\"f\":\"%s\",\"lo\":%.4f,\"la\":%.4f,\"ll\":%.4f,\"lt\":%.4f}",
                    index > 0 ? "," : "",
                    d->plane_data.icao,
                    d->plane_data.lon,
                    d->plane_data.lat,
                    d->gps_data.lon,
                    d->gps_data.lat);
        k_msleep(20);
        index++;
    }

    printk("]\n");

    struct HEAP_NODE out;
    while (min_heap_pop(&planeheap, &out) == 0) {
        /* popped one */
    }
    return 0;
}
```

## src/minheap.h
```c
#ifndef MINHEAP_H
#define MINHEAP_H

#include <stddef.h>
#include "protocol.h"

#define MAX_HEAP_SIZE 30
#define FLIGHT_NAME_MAX_LEN 6

struct HEAP_NODE {
    airplane_t plane_data;
    gps_location_t gps_data;
};

void print_heap();

#define FLOAT_STR_LEN 12

struct HEAP_JSON {
    char *flightName[MAX_HEAP_SIZE];

    char longitudeStr[MAX_HEAP_SIZE][FLOAT_STR_LEN];
    char latitudeStr[MAX_HEAP_SIZE][FLOAT_STR_LEN];
    char loclongStr[MAX_HEAP_SIZE][FLOAT_STR_LEN];
    char loclatStr[MAX_HEAP_SIZE][FLOAT_STR_LEN];

    size_t heap_len;
};

int insert_into_heap(gps_location_t gps_data, airplane_t plane_data);

int convert_heap_to_string();

#endif /* MINHEAP_H */
```

## src/shell.c
```c
/*********************************** */
/*             shell.c               */
/*********************************** */
/* Authors                           */
/* Sidney Neil 47441952              */
/* Fiachra Richards 47450271         */
/*********************************** */

/********* Include Libraries ******* */
#include <zephyr/kernel.h>
#include <zephyr/shell/shell.h>

#include <stdlib.h>
#include <errno.h>

#include "shell.h"
#include "minheap.h"
/*********************************** */

static int parse_float_arg(const struct shell *sh, const char *arg, float *out)
{
    char *end = NULL;

    if (arg == NULL || out == NULL) {
        shell_error(sh, "Invalid argument");
        return -EINVAL;
    }

    errno = 0;
    float value = strtof(arg, &end);

    if (errno != 0 || end == arg || *end != '\0') {
        shell_error(sh, "Invalid float value: %s", arg);
        return -EINVAL;
    }

    *out = value;
    return 0;
}

/*
 * Usage:
 * plane add <flightName> <longitude> <latitude> <loclong> <loclat>
 *
 * Example:
 * plane add QFA123 153.0251 -27.4698 153.0100 -27.4600
 */
static int cmd_plane_add(const struct shell *sh, size_t argc, char **argv)
{
    ARG_UNUSED(argc);

    const char *flightName = argv[1];

    float longitude;
    float latitude;
    float loclong;
    float loclat;

    int ret;

    ret = parse_float_arg(sh, argv[2], &longitude);
    if (ret != 0) {
        return ret;
    }

    ret = parse_float_arg(sh, argv[3], &latitude);
    if (ret != 0) {
        return ret;
    }

    ret = parse_float_arg(sh, argv[4], &loclong);
    if (ret != 0) {
        return ret;
    }

    ret = parse_float_arg(sh, argv[5], &loclat);
    if (ret != 0) {
        return ret;
    }

    ret = insert_into_heap(flightName,
                           longitude,
                           latitude,
                           loclong,
                           loclat);

    if (ret != 0) {
        printk("Failed to add plane %s: %d", flightName, ret);
        return ret;
    }

    printk("Added PLane");

    return 0;
}

/*
 * Usage:
 * plane print
 */
static int cmd_plane_print(const struct shell *sh, size_t argc, char **argv)
{
    char json_buf[HEAP_JSON_BUF_SIZE];
    int ret = convert_heap_to_string(json_buf, sizeof(char) * HEAP_JSON_BUF_SIZE);

    if (ret != 0) {
        printk("Failed to encode heap JSON: %d", ret);
        return ret;
    }
    return 0;
}

/*
 * plane add   <flightName> <longitude> <latitude> <loclong> <loclat>
 * plane print
 */
SHELL_STATIC_SUBCMD_SET_CREATE(
    sub_plane,

    SHELL_CMD_ARG(add,
                  NULL,
                  "Add plane to heap.\n"
                  "Usage: plane add <flightName> <longitude> <latitude> <loclong> <loclat>",
                  cmd_plane_add,
                  6,
                  0),

    SHELL_CMD_ARG(print,
                  NULL,
                  "Print current heap as JSON.\n"
                  "Usage: plane print",
                  cmd_plane_print,
                  1,
                  0),

    SHELL_SUBCMD_SET_END
);

SHELL_CMD_REGISTER(plane, &sub_plane, "Plane heap commands", NULL);
```
