## CMakeLists.txt
```
# SPDX-License-Identifier: Apache-2.0

cmake_minimum_required(VERSION 3.20.0)
find_package(Zephyr REQUIRED HINTS $ENV{ZEPHYR_BASE})
project(sensor_node)

target_sources(app PRIVATE
    src/main.c
    src/ble_transfer.c
    src/gps_driver.c
    src/serial.c
    ${CMAKE_CURRENT_SOURCE_DIR}/../lib/src/protocol.c
)

target_include_directories(app PRIVATE
    ${CMAKE_CURRENT_SOURCE_DIR}/src
    ${CMAKE_CURRENT_SOURCE_DIR}/../lib/src
)
```

## prj.conf
```kconfig
# -----------------------------
# I2C Support (GPS)
# -----------------------------
CONFIG_I2C=y
CONFIG_I2C_NRFX=y

# -----------------------------
# Logging / Console
# -----------------------------
CONFIG_LOG=y
CONFIG_LOG_DEFAULT_LEVEL=3
CONFIG_PRINTK=y
CONFIG_STDOUT_CONSOLE=y

# -----------------------------
# Thread stack
# -----------------------------
CONFIG_MAIN_STACK_SIZE=4096

# -----------------------------
# Bluetooth + NUS
# -----------------------------
CONFIG_BT=y
CONFIG_BT_OBSERVER=y
CONFIG_BT_PERIPHERAL=y
CONFIG_BT_ZEPHYR_NUS=y
CONFIG_BT_DEVICE_NAME="sensor_node"

# Larger BLE payload support
CONFIG_BT_BUF_ACL_RX_SIZE=251
CONFIG_BT_BUF_ACL_TX_SIZE=251
CONFIG_BT_L2CAP_TX_MTU=247
CONFIG_BT_CTLR_DATA_LENGTH_MAX=251

# -----------------------------
# USB CDC ACM Serial (legacy USB stack)
# -----------------------------
CONFIG_SERIAL=y
CONFIG_UART_LINE_CTRL=y
CONFIG_USB_DEVICE_STACK=y
CONFIG_USB_CDC_ACM=y
CONFIG_USB_DEVICE_STACK_NEXT=n
CONFIG_USBD_CDC_ACM_CLASS=n

# Fix float formatting
CONFIG_PICOLIBC_IO_FLOAT=y
CONFIG_CBPRINTF_FP_SUPPORT=y

CONFIG_JSON_LIBRARY=y
CONFIG_JSON_LIBRARY_FP_SUPPORT=y
```

## src/main.c
```c
#include <zephyr/sys/printk.h>
#include <zephyr/sys/util.h>
#include <zephyr/kernel.h>
#include <zephyr/data/json.h>
#include <stdio.h>
#include "ble_transfer.h"
#include "gps_driver.h"
#include "serial.h"
#include "protocol.h"

static int parse_plane_csv(const char *raw, airplane_t *out)
{
    if (!raw || !out) {
        return -1;
    }

    int matched = sscanf(raw,
                         "%7[^,],%lf,%lf,%lf,%lf,%lf,%15[^\r\n]",
                         out->icao,
                         &out->alt,
                         &out->lat,
                         &out->lon,
                         &out->spd,
                         &out->head,
                         out->ts);

    return (matched == 7) ? 0 : -1;
}

int main(void)
{
    int err = serial_init();
    if (err) {
        printk("serial_init failed: %d\n", err);
        return 0;
    }

    err = init_nus();
    if (err) {
        printk("bluetooth_init failed: %d\n", err);
        return 0;
    }
    gps_location_t current_loc;
    current_loc.lat = -27.497358;
    current_loc.lon = 153.013259;
    current_loc.alt = 10.00;
    current_loc.valid = true;

    while (1) {
        gps_location_t new_loc = get_location();

        if (new_loc.valid) {
            // Update current location with new gps info
            char msg[200];
            current_loc.lat = new_loc.lat;
            current_loc.lon = new_loc.lon;
            current_loc.alt = new_loc.alt;
            snprintf(msg, sizeof(msg),
                     "{\"lat\":%.6f,\"lon\":%.6f,\"alt\":%.2f}",
                     new_loc.lat, new_loc.lon, new_loc.alt);
            printk("Received GPS: %s\n", msg);
        } else {
            printk("Waiting for GPS fix...\n");
        }
        char* raw_plane_data = serial_read_line();
        if (raw_plane_data) {
            printk("%s\n", raw_plane_data);
        }
        airplane_t plane = {0};

        if (raw_plane_data && parse_plane_csv(raw_plane_data, &plane) == 0) {
            printk("plane: %s alt=%.1f lat=%.6f lon=%.6f spd=%.1f head=%.1f ts=%s\n",
       plane.icao, plane.alt, plane.lat, plane.lon, plane.spd, plane.head, plane.ts);
        }

        sensor_message_t message = {
            .gps = current_loc,
            .plane = plane,
        };

        char ble_msg[247] = {0};

        err = json_obj_encode_buf(sensor_message_descr,
                                  sensor_message_descr_len,
                                  &message,
                                  ble_msg,
                                  sizeof(ble_msg));

        if (err < 0) {
            printk("json_obj_encode_buf failed: %d\n", err);
        } else {
            // printk("%s\n", ble_msg);
            send_over_nus(ble_msg);
        }
        k_msleep(1000);
    }

    return 0;
}
```

## src/ble_transfer.c
```c
/*
Simple bluetooth nus helper
*/
#include <string.h>
#include <zephyr/bluetooth/bluetooth.h>
#include <zephyr/bluetooth/services/nus.h>
#include <zephyr/bluetooth/hci.h>

#define DEVICE_NAME     CONFIG_BT_DEVICE_NAME
#define DEVICE_NAME_LEN     (sizeof(DEVICE_NAME) - 1)

static const struct bt_data ad[] = {
    BT_DATA_BYTES(BT_DATA_FLAGS, (BT_LE_AD_GENERAL | BT_LE_AD_NO_BREDR)),
    BT_DATA(BT_DATA_NAME_COMPLETE, DEVICE_NAME, DEVICE_NAME_LEN),
};

static const struct bt_data sd[] = {
    BT_DATA_BYTES(BT_DATA_UUID128_ALL, BT_UUID_NUS_SRV_VAL),
};

static bool nus_ready = false;

int init_nus(void) {
    int err;
    if (nus_ready) {
        return 0;
    }

    err = bt_enable(NULL);
    if (err) {
        return err;
    }

    err = bt_le_adv_start(BT_LE_ADV_CONN_FAST_1, ad, ARRAY_SIZE(ad), sd, ARRAY_SIZE(sd));
    if (err && err != -EALREADY) return err;

    nus_ready = true;
    return 0;
}

int send_over_nus(char *msg) {
    int err = init_nus();
    if (err) {
        return err;
    }
    if (msg == NULL) {
        return -EINVAL;
    }
    err = bt_nus_send(NULL, msg, strlen(msg));
    if (err == -ENOTCONN) {
         bt_le_adv_start(BT_LE_ADV_CONN_FAST_1, ad, ARRAY_SIZE(ad), sd, ARRAY_SIZE(sd));
    }
    return err;
}
```

## src/ble_transfer.h
```c
#ifndef BLE_TRANSFER_H
#define BLE_TRANSFER_H

int send_over_nus(char *msg);
int init_nus(void);

#endif
```

## src/gps_driver.c
```c
#include "gps_driver.h"
#include <stdbool.h>
#include <stdint.h>
#include <zephyr/kernel.h>
#include <zephyr/device.h>
#include <zephyr/devicetree.h>
#include <zephyr/drivers/i2c.h>

#include <stdbool.h>
#include <stdint.h>
#include <stdlib.h>
#include <string.h>

#define UBLOX_ADDR 0x42
#define NMEA_MAX_LEN 128

#define GPS_THREAD_STACK_SIZE 2048
#define GPS_THREAD_PRIORITY 7
#define GPS_POLL_MS 50

static const struct device *gps_i2c;
static char nmea_buf[NMEA_MAX_LEN];
static int nmea_len;

static gps_location_t g_loc;
K_MUTEX_DEFINE(g_loc_mutex);

static bool nmea_to_decimal(const char *coord, const char *hemi, double *out_deg)
{
    if (!coord || !hemi || !out_deg || coord[0] == '\0' || hemi[0] == '\0') {
        return false;
    }

    char *endp = NULL;
    double raw = strtod(coord, &endp);
    if (endp == coord || raw <= 0.0) {
        return false;
    }

    int deg = (int)(raw / 100.0);
    double min = raw - (deg * 100.0);
    double dec = (double)deg + (min / 60.0);

    if (hemi[0] == 'S' || hemi[0] == 'W') {
        dec = -dec;
    }

    *out_deg = dec;
    return true;
}

static void update_fix(double lat, double lon, double alt)
{
    k_mutex_lock(&g_loc_mutex, K_FOREVER);
    g_loc.lat = lat;
    g_loc.lon = lon;
    g_loc.alt = alt;
    g_loc.valid = true;
    g_loc.fix_seq++;
    k_mutex_unlock(&g_loc_mutex);
}

static char *next_csv_field(char **s)
{
    if (!s || !*s) {
        return NULL;
    }

    char *start = *s;
    char *comma = strchr(start, ',');

    if (comma) {
        *comma = '\0';
        *s = comma + 1;
    } else {
        *s = NULL;
    }

    return start;
}

/* Minimal: only accept GNGGA sentences */
static void parse_gngga(char *s)
{
    if (*s == '$') {
        s++;
    }

    char *type = next_csv_field(&s);
    if (!type || strcmp(type, "GNGGA") != 0) {
        return;
    }

    (void)next_csv_field(&s);   /* time */
    char *lat      = next_csv_field(&s);
    char *lat_hemi = next_csv_field(&s);
    char *lon      = next_csv_field(&s);
    char *lon_hemi = next_csv_field(&s);
    char *fix_q    = next_csv_field(&s);
    (void)next_csv_field(&s);   /* sats */
    (void)next_csv_field(&s);   /* hdop */
    char *alt      = next_csv_field(&s);

    if (!fix_q || fix_q[0] == '0') {
        return;
    }

    double lat_dd, lon_dd;
    if (!nmea_to_decimal(lat, lat_hemi, &lat_dd) ||
        !nmea_to_decimal(lon, lon_hemi, &lon_dd)) {
        return;
    }

    double alt_m = 0.0;
    if (alt && alt[0] != '\0') {
        char *endp = NULL;
        double parsed = strtod(alt, &endp);
        if (endp != alt) {
            alt_m = parsed;
        }
    }

    update_fix(lat_dd, lon_dd, alt_m);
}

static void parse_nmea_sentence(char *line)
{
    char *star = strrchr(line, '*');
    if (!star || line[0] != '$') {
        return;
    }

    uint8_t cs_calc = 0;
    for (char *p = line + 1; p < star; p++) {
        cs_calc ^= (uint8_t)*p;
    }

    uint8_t cs_recv = (uint8_t)strtoul(star + 1, NULL, 16);
    if (cs_calc != cs_recv) {
        return;
    }

    if (strncmp(line, "$GNGGA", 6) == 0) {
        parse_gngga(line);
    }
}

static void nmea_feed_byte(uint8_t buf)
{
    if (buf == '$') {
        nmea_len = 0;
        nmea_buf[nmea_len++] = '$';
        return;
    }

    if (nmea_len == 0) {
        return;
    }

    if (nmea_len < (NMEA_MAX_LEN - 1)) {
        nmea_buf[nmea_len++] = (char)buf;
    }

    if (buf == '\n') {
        nmea_buf[nmea_len] = '\0';
        parse_nmea_sentence(nmea_buf);
        nmea_len = 0;
    }
}

static void gps_thread()
{
    gps_i2c = DEVICE_DT_GET(DT_NODELABEL(i2c1));
    if (!device_is_ready(gps_i2c)) {
        return;
    }

    while (1) {
        uint8_t buf[64];
        int ret = i2c_read(gps_i2c, buf, sizeof(buf), UBLOX_ADDR);
        if (ret == 0) {
            for (size_t i = 0; i < sizeof(buf); i++) {
                nmea_feed_byte(buf[i]);
            }
        }

        k_msleep(GPS_POLL_MS);
    }
}

K_THREAD_DEFINE(gps_id, GPS_THREAD_STACK_SIZE, gps_thread,
                NULL, NULL, NULL, GPS_THREAD_PRIORITY, 0, 0);

gps_location_t get_location(void)
{
    gps_location_t out;
    k_mutex_lock(&g_loc_mutex, K_FOREVER);
    out = g_loc;
    k_mutex_unlock(&g_loc_mutex);
    return out;
}
```

## src/gps_driver.h
```c
#ifndef GPS_DRIVER_H
#define GPS_DRIVER_H

#include "protocol.h"

/* Thread updates this continuously; caller just reads snapshot. */
gps_location_t get_location(void);

#endif
```

## src/serial.c
```c
/* serial.c */
#include "serial.h"

#include <zephyr/kernel.h>
#include <zephyr/device.h>
#include <zephyr/drivers/uart.h>
#include <zephyr/usb/usb_device.h>
#include <zephyr/devicetree.h>
#include <errno.h>
#include <stdint.h>

#define SERIAL_LINE_MAX 128

static const struct device *usb_uart;
static char line_buf[SERIAL_LINE_MAX];
static size_t line_idx;

int serial_init(void)
{
    usb_uart = DEVICE_DT_GET_ONE(zephyr_cdc_acm_uart);
    if (!device_is_ready(usb_uart)) {
        return -ENODEV;
    }

    if (usb_enable(NULL) != 0) {
        return -EIO;
    }
    line_idx = 0;
    return 0;
}

char *serial_read_line(void)
{
    if (!usb_uart) {
        return NULL;
    }

    /* If host terminal is not open yet, just report no line */
    uint32_t dtr = 0;
    if (uart_line_ctrl_get(usb_uart, UART_LINE_CTRL_DTR, &dtr) != 0 || !dtr) {
        return NULL;
    }

    uint8_t c;
    while (uart_poll_in(usb_uart, &c) == 0) {
        if (c == '\n' || c == '\r') {
            if (line_idx == 0) {
                continue;
            }

            line_buf[line_idx] = '\0';
            line_idx = 0;
            return line_buf;
        }

        if (line_idx < (SERIAL_LINE_MAX - 1)) {
            line_buf[line_idx++] = (char)c;
        } else {
            line_idx = 0;
        }
    }

    return NULL;
}
```

## src/serial.h
```c
/* serial.h */
#ifndef SERIAL_H
#define SERIAL_H

/* Returns 0 on success, negative errno on failure */
int serial_init(void);

/*
 * Non-blocking line read.
 * Returns:
 * - pointer to internal null-terminated line buffer when a full line is ready
 * - NULL otherwise
 */
char *serial_read_line(void);

#endif
```
