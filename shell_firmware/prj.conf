## CMakeLists.txt
```
cmake_minimum_required(VERSION 3.20.0)

find_package(Zephyr REQUIRED HINTS $ENV{ZEPHYR_BASE})
project(central)

target_sources(app PRIVATE
  src/main.c
  src/minheap.c
  src/shell.c
)

zephyr_library_include_directories(${ZEPHYR_BASE}/samples/bluetooth)

target_include_directories(app PRIVATE
  ${CMAKE_CURRENT_SOURCE_DIR}/lib
  ${CMAKE_CURRENT_SOURCE_DIR}/src
)
```

## prj.conf
```kconfig
CONFIG_BT=y
CONFIG_BT_CENTRAL=y
CONFIG_BT_GATT_CLIENT=y
CONFIG_BT_ZEPHYR_NUS=y
CONFIG_JSON_LIBRARY=y
CONFIG_SHELL=y
CONFIG_SHELL_BACKEND_SERIAL=y
CONFIG_UART_CONSOLE=y
CONFIG_FPU=y
CONFIG_FPU_SHARING=y
CONFIG_CBPRINTF_FP_SUPPORT=y
CONFIG_MIN_HEAP=y

CONFIG_HEAP_MEM_POOL_SIZE=4096
CONFIG_USB_CDC_ACM_RINGBUF_SIZE=4096
CONFIG_SHELL_BACKEND_SERIAL_TX_RING_BUFFER_SIZE=4096
CONFIG_CBPRINTF_FP_SUPPORT=y
```

## src/main.c
```c
/*********************************** */
/*            main.c                 */
/*********************************** */
/* Authors                           */
/* Sidney Neil 47441952              */
/* Fiachra Richards  47450271        */
/*********************************** */

#include <zephyr/kernel.h>

int main(void)
{
    return 0;
}
```

## src/minheap.c
```c
#include "minheap.h"

#include <zephyr/kernel.h>
#include <zephyr/sys/min_heap.h>
#include <zephyr/data/json.h>
#include <zephyr/sys/util.h>
#include <zephyr/shell/shell.h>



#include <errno.h>
#include <stdbool.h>
#include <string.h>

int min_heap_count();


// static const struct json_obj_descr heap_json_descr[] = {
// 	JSON_OBJ_DESCR_ARRAY(struct HEAP_JSON,
// 			     flightName,
// 			     MAX_HEAP_SIZE,
// 			     heap_len,
// 			     JSON_TOK_STRING),

// 	JSON_OBJ_DESCR_ARRAY(struct HEAP_JSON,
// 			     longitude,
// 			     MAX_HEAP_SIZE,
// 			     heap_len,
// 			     JSON_TOK_FLOAT_FP),

// 	JSON_OBJ_DESCR_ARRAY(struct HEAP_JSON,
// 			     latitude,
// 			     MAX_HEAP_SIZE,
// 			     heap_len,
// 			     JSON_TOK_FLOAT_FP),

// 	JSON_OBJ_DESCR_ARRAY(struct HEAP_JSON,
// 			     loclong,
// 			     MAX_HEAP_SIZE,
// 			     heap_len,
// 			     JSON_TOK_FLOAT_FP),

// 	JSON_OBJ_DESCR_ARRAY(struct HEAP_JSON,
// 			     loclat,
// 			     MAX_HEAP_SIZE,
// 			     heap_len,
// 			     JSON_TOK_FLOAT_FP),
// };

/*
 * Returns the squared Euclidean distance between a plane's position and the
 * observer location in (longitude, latitude) space. Note: this is a flat-earth
 * approximation suitable for small geographic areas only; degree units are not
 * isotropic at non-zero latitudes.
 */
static float heap_node_distance_squared(const struct HEAP_NODE *node)
{
	float dx = node->longitude - node->loclong;
	float dy = node->latitude - node->loclat;

	return (dx * dx) + (dy * dy);
}

static int compare_heap_nodes(const void *a, const void *b)
{
	const struct HEAP_NODE *da = a;
	const struct HEAP_NODE *db = b;

	float difa = heap_node_distance_squared(da);
	float difb = heap_node_distance_squared(db);

	if (difa < difb) {
		return -1;
	}

	if (difa > difb) {
		return 1;
	}

	return 0;
}

static bool match_flight_name(const void *a, const void *b)
{
	const struct HEAP_NODE *node = a;
	const char *flightName = b;

	if (flightName == NULL) {
		return false;
	}

	return strcmp(node->flightName, flightName) == 0;
}

MIN_HEAP_DEFINE_STATIC(planeheap,
		       MAX_HEAP_SIZE,
		       sizeof(struct HEAP_NODE),
		       __alignof__(struct HEAP_NODE),
		       compare_heap_nodes);

int insert_into_heap(const char *flightName,
		     float longitude,
		     float latitude,
		     float loclong,
		     float loclat)
{
	struct HEAP_NODE node = {0};
	struct HEAP_NODE deletednode = {0};
	size_t index;

	if (flightName == NULL) {
		return -EINVAL;
	}

	strncpy(node.flightName, flightName, sizeof(node.flightName) - 1);
	node.flightName[sizeof(node.flightName) - 1] = '\0';

	node.longitude = longitude;
	node.latitude = latitude;
	node.loclong = loclong;
	node.loclat = loclat;

	int ret = min_heap_push(&planeheap, &node);

	if (ret != 0) {
		printk("insert_into_heap: failed to push %s: %d\n", flightName, ret);
		return ret;
	}

	return 0;
}
int min_heap_count(){
    void* elem;
	int count = 0;

    MIN_HEAP_FOREACH(&planeheap, elem) {
		struct HEAP_NODE *d = elem;

		count++;
	}
	return count;
}

int convert_heap_to_string()
{

    void *elem;
    size_t index = 0;
	size_t newindex = 0;
	struct HEAP_NODE deletednode = {0};


    printk("[");

    MIN_HEAP_FOREACH(&planeheap, elem) {
        struct HEAP_NODE *d = elem;

        printk("%s{\"f\":\"%s\",\"lo\":%.4f,\"la\":%.4f,\"ll\":%.4f,\"lt\":%.4f}",
                    index > 0 ? "," : "",
                    d->flightName,
                    (double)d->longitude,
                    (double)d->latitude,
                    (double)d->loclong,
                    (double)d->loclat);


        k_msleep(20);
        index++;
    }

    printk("]\n");

	struct HEAP_NODE *d = elem;

	while (min_heap_pop(&planeheap, &d)){ /*Empty Minheap*/}
    return 0;
}
```

## src/minheap.h
```c
#ifndef MINHEAP_H
#define MINHEAP_H

#include <stddef.h>

#define MAX_HEAP_SIZE 30
#define FLIGHT_NAME_MAX_LEN 16

struct HEAP_NODE {
    char flightName[FLIGHT_NAME_MAX_LEN];

    float longitude;
    float latitude;

    float loclong;
    float loclat;
};

void print_heap();

#define FLOAT_STR_LEN 12

struct HEAP_JSON {
    char *flightName[MAX_HEAP_SIZE];

    char longitudeStr[MAX_HEAP_SIZE][FLOAT_STR_LEN];
    char latitudeStr[MAX_HEAP_SIZE][FLOAT_STR_LEN];
    char loclongStr[MAX_HEAP_SIZE][FLOAT_STR_LEN];
    char loclatStr[MAX_HEAP_SIZE][FLOAT_STR_LEN];

    size_t heap_len;
};

int insert_into_heap(const char *flightName,
                     float longitude,
                     float latitude,
                     float loclong,
                     float loclat);

int convert_heap_to_string(char *json_buf, size_t json_buf_size);

#endif /* MINHEAP_H */
```

## src/shell.h
```c
#ifndef APP_SHELL_H
#define APP_SHELL_H

/*
 * Plane heap shell commands:
 *
 * plane add <flightName> <longitude> <latitude> <loclong> <loclat>
 * plane print
 */

#define HEAP_JSON_BUF_SIZE 700

#endif /* APP_SHELL_H */
```
